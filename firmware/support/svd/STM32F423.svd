# STM32F423 register map
File version: 1.2
STM32F423; repository corrections documented in firmware/support/README.md
CPU: CM4 r0p1, little endian, MPU, FPU, 4 interrupt priority bits
Registers are 32-bit, read-write, reset 0x0 unless marked. A register's access mark holds for its fields unless they carry their own. Offsets are from the block's base; lines under a group give offsets from that group; [hi:lo] are bit positions; {n}, {i} and the like mark numbered series; 'fields as' and 'values as' point back to an identical list; <NAME> marks a mode.

## Memory map
0x40000000 TIM2 size 0x55 — General purpose timers
0x40000400 TIM3 size 0x51 — General purpose timers
0x40000800 TIM4 size 0x51
0x40000C00 TIM5 size 0x55 — General-purpose-timers
0x40001000 TIM6 size 0x51
0x40001400 TIM7 size 0x51 — Basic timers
0x40001800 TIM12 size 0x3D — General purpose timers
0x40001C00 TIM13 size 0x3D — General purpose timers
0x40002000 TIM14 size 0x3D
0x40002400 LPTIM size 0x21 — Low power timer
0x40002800 RTC size 0xA1 — Real-time clock
0x40002C00 WWDG size 0x11 — Window watchdog
0x40003000 IWDG size 0x11 — Independent watchdog
0x40003800 SPI2 size 0x400
0x40003C00 SPI3 size 0x400
0x40004400 USART2 size 0x1D
0x40004800 USART3 size 0x1D — Universal synchronous asynchronous receiver transmitter
0x40004C00 UART4 size 0x1D
0x40005000 UART5 size 0x1D
0x40005400 I2C1 size 0x29
0x40005800 I2C2 size 0x29 — Inter-integrated circuit
0x40005C00 I2C3 size 0x29
0x40006000 FMPI2C size 0x2D — fast-mode Inter-integrated circuit
0x40006400 CAN1 size 0x321 — Controller area network
0x40006800 CAN2 size 0x200 — CAN2; shared filter registers are accessed through CAN1
0x40006C00 CAN3 size 0x321 — CAN3 with 14 independent filter banks
0x40007000 PWR size 0x9 — Power control
0x40007400 DAC size 0x39 — Digital-to-analog converter
0x40007800 UART7 size 0x1D
0x40007C00 UART8 size 0x1D
0x40010000 TIM1 size 0x51 — Advanced-timers
0x40010400 TIM8 size 0x51
0x40011000 USART1 size 0x1D
0x40011400 USART6 size 0x1D
0x40011800 UART9 size 0x1D
0x40011C00 UART10 size 0x1D
0x40012000 ADC1 size 0x51 — Analog-to-digital converter
0x40012300 ADC_Common size 0x9 — ADC common registers
0x40012C00 SDIO size 0x85 — Secure digital input/output interface
0x40013000 SPI1 size 0x400
0x40013400 SPI4 size 0x400
0x40013800 SYSCFG size 0x31 — System configuration controller
0x40013C00 EXTI size 0x19 — External interrupt/event controller
0x40014000 TIM9 size 0x3D — General purpose timers
0x40014400 TIM10 size 0x39 — General-purpose-timers
0x40014800 TIM11 size 0x400 — General-purpose-timers
0x40015000 SPI5 size 0x400 — Serial peripheral interface
0x40015800 SAI size 0x400 — Serial audio interface
0x40016000 DFSDM1 size 0x400
0x40016400 DFSDM2 size 0x400 — Digital filter for sigma delta modulators
0x40020000 GPIOA size 0x29 — General-purpose I/Os
0x40020400 GPIOB size 0x29 — General-purpose I/Os
0x40020800 GPIOC size 0x29
0x40020C00 GPIOD size 0x29
0x40021000 GPIOE size 0x29
0x40021400 GPIOF size 0x29 — General-purpose I/Os
0x40021800 GPIOG size 0x29
0x40021C00 GPIOH size 0x29
0x40023000 CRC size 0xD — Cryptographic processor
0x40023800 RCC size 0x99 — Reset and clock control
0x40023C00 FLASH size 0x19
0x40026000 DMA1 size 0x400 — DMA controller
0x40026400 DMA2 size 0x400
0x50000000 OTG_FS_GLOBAL size 0x111 — USB on the go full speed
0x50000400 OTG_FS_HOST size 0x1F5 — USB on the go full speed
0x50000800 OTG_FS_DEVICE size 0x375 — USB on the go full speed
0x50000E00 OTG_FS_PWRCLK size 0x5 — USB on the go full speed
0x50060000 AES size 0x31 — Advanced encryption standard hardware accelerator
0x50060800 RNG size 0x11 — Random number generator
0xA0000000 FSMC size 0x400 — Flexible static memory controller
0xA0001000 QUADSPI size 0x35 — QuadSPI interface
0xE000EF30 FPU — FPU interrupt metadata; core registers are provided by the debugger.
0xE0042000 DBG size 0x11 — Debug support

## Interrupts
0 WWDG
1 PVD (PWR)
2 TAMP_STAMP (RTC)
3 RTC_WKUP (RTC)
4 FLASH
5 RCC
6 EXTI0 (EXTI)
7 EXTI1 (EXTI)
8 EXTI2 (EXTI)
9 EXTI3 (EXTI)
10 EXTI4 (EXTI)
11 DMA1_Stream0 (DMA1)
12 DMA1_Stream1 (DMA1)
13 DMA1_Stream2 (DMA1)
14 DMA1_Stream3 (DMA1)
15 DMA1_Stream4 (DMA1)
16 DMA1_Stream5 (DMA1)
17 DMA1_Stream6 (DMA1)
18 ADC (ADC1)
19 CAN1_TX (CAN1)
20 CAN1_RX0 (CAN1)
21 CAN1_RX1 (CAN1)
22 CAN1_SCE (CAN1)
23 EXTI9_5 (EXTI)
24 TIM1_BRK_TIM9 (TIM1, TIM9)
25 TIM1_UP_TIM10 (TIM1, TIM10)
26 TIM1_TRG_COM_TIM11 (TIM1, TIM11)
27 TIM1_CC (TIM1)
28 TIM2
29 TIM3
30 TIM4
31 I2C1_EV (I2C1)
32 I2C1_ER (I2C1)
33 I2C2_EV (I2C2)
34 I2C2_ER (I2C2)
35 SPI1
36 SPI2
37 USART1
38 USART2
39 USART3
40 EXTI15_10 (EXTI)
41 RTC_Alarm (RTC)
42 OTG_FS_WKUP (OTG_FS_GLOBAL)
43 TIM8_BRK_TIM12 (TIM8, TIM12)
44 TIM8_UP_TIM13 (TIM8, TIM13)
45 TIM8_TRG_COM_TIM14 (TIM8, TIM14)
46 TIM8_CC (TIM8)
47 DMA1_Stream7 (DMA1)
49 SDIO
50 TIM5
51 SPI3
52 UART4
53 UART5
54 TIM6_DAC (TIM6, DAC)
55 TIM7
56 DMA2_Stream0 (DMA2)
57 DMA2_Stream1 (DMA2)
58 DMA2_Stream2 (DMA2)
59 DMA2_Stream3 (DMA2)
60 DMA2_Stream4 (DMA2)
61 DFSDM1_FLT0 (DFSDM1)
62 DFSDM1_FLT1 (DFSDM1)
63 CAN2_TX (CAN2)
64 CAN2_RX0 (CAN2)
65 CAN2_RX1 (CAN2)
66 CAN2_SCE (CAN2)
67 OTG_FS (OTG_FS_GLOBAL)
68 DMA2_Stream5 (DMA2)
69 DMA2_Stream6 (DMA2)
70 DMA2_Stream7 (DMA2)
71 USART6
72 I2C3_EV (I2C3)
73 I2C3_ER (I2C3)
74 CAN3_TX (CAN3)
75 CAN3_RX0 (CAN3)
76 CAN3_RX1 (CAN3)
77 CAN3_SCE (CAN3)
79 AES
80 RNG
81 FPU
82 UART7
83 UART8
84 SPI4
85 SPI5
87 SAI1 (SAI)
88 UART9
89 UART10
92 QUADSPI
95 FMPI2C1_EV (FMPI2C)
96 FMPI2C1_ER (FMPI2C)
97 LPTIM1 (LPTIM)
98 DFSDM2_FLT0 (DFSDM2)
99 DFSDM2_FLT1 (DFSDM2)
100 DFSDM2_FLT2 (DFSDM2)
101 DFSDM2_FLT3 (DFSDM2)

## Notices in the file
Copyright (c) 2024 STMicroelectronics.
SPDX-License-Identifier: Apache-2.0
Licensed under the Apache License, Version 2.0 (the "License");
you may not use this file except in compliance with the License.
You may obtain a copy of the License at
http://www.apache.org/licenses/LICENSE-2.0
Unless required by applicable law or agreed to in writing, software
distributed under the License is distributed on an "AS IS" BASIS,
WITHOUT WARRANTIES OR CONDITIONS OF ANY KIND, either express or implied.
See the License for the specific language governing permissions and
limitations under the License.
